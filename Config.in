## Config.in
```kconfig
source "$BR2_EXTERNAL_BRICK_PATH/package/brick-gpu/Config.in"
source "$BR2_EXTERNAL_BRICK_PATH/package/brick-devtools/Config.in"
source "$BR2_EXTERNAL_BRICK_PATH/package/brick-radio/Config.in"
source "$BR2_EXTERNAL_BRICK_PATH/package/brick-bluetooth-identity/Config.in"
source "$BR2_EXTERNAL_BRICK_PATH/package/brick-controls/Config.in"
source "$BR2_EXTERNAL_BRICK_PATH/package/brick-power/Config.in"
source "$BR2_EXTERNAL_BRICK_PATH/package/brick-scp/Config.in"
source "$BR2_EXTERNAL_BRICK_PATH/package/brick-emmc-recovery/Config.in"
source "$BR2_EXTERNAL_BRICK_PATH/package/brick-encoder-qualification/Config.in"

config BR2_BRICK_G2D_QUALIFICATION
	bool "Brick G2D qualification profile"
	help
	  Enable only the stock-wired A133 IOMMU and G2D engine in the
	  generated Brick DTB. The ordinary image keeps the engine disabled.

config BR2_BRICK_VE_QUALIFICATION
	bool "Brick video-engine qualification profile"
	help
	  Enable the A133 IOMMU, both reviewed video SRAM selectors and the
	  Cedrus video engine in the generated Brick DTB. This isolated profile
	  is intended for deterministic codec and DMA-containment qualification;
	  the ordinary image keeps every accelerator node disabled.

config BR2_BRICK_VP9_QUALIFICATION
	bool "Brick VP9 qualification profile"
	help
	  Enable only the reviewed A133 Hantro G2 VP9 engine and its shared
	  video clock/reset provider. The ordinary image keeps the engine
	  disabled, and the isolated profile does not enable an IOMMU mapping.

config BR2_BRICK_CE_TRNG_QUALIFICATION
	bool "Brick CE/TRNG qualification profile"
	help
	  Enable the reviewed A133 crypto engine and its zero-entropy-credit
	  TRNG transport in an isolated image. The ordinary image keeps the
	  crypto node and TRNG transport disabled.

source "$BR2_EXTERNAL_BRICK_PATH/package/brick-accelerator-qualification/Config.in"
source "$BR2_EXTERNAL_BRICK_PATH/package/brick-ce-trng-qualification/Config.in"
```

## configs/brick_defconfig
```kconfig
BR2_aarch64=y
BR2_cortex_a53=y
BR2_TOOLCHAIN_EXTERNAL=y
BR2_TOOLCHAIN_EXTERNAL_CUSTOM=y
BR2_TOOLCHAIN_EXTERNAL_DOWNLOAD=y
BR2_TOOLCHAIN_EXTERNAL_URL="https://developer.arm.com/-/media/Files/downloads/gnu/14.3.rel1/binrel/arm-gnu-toolchain-14.3.rel1-x86_64-aarch64-none-linux-gnu.tar.xz"
BR2_TOOLCHAIN_EXTERNAL_CUSTOM_PREFIX="aarch64-none-linux-gnu"
BR2_TOOLCHAIN_EXTERNAL_GCC_14=y
BR2_TOOLCHAIN_EXTERNAL_HEADERS_4_20=y
BR2_TOOLCHAIN_EXTERNAL_CUSTOM_GLIBC=y
BR2_TOOLCHAIN_EXTERNAL_CXX=y
# BR2_TOOLCHAIN_EXTERNAL_INET_RPC is not set
BR2_GLOBAL_PATCH_DIR="$(BR2_EXTERNAL_BRICK_PATH)/board/trimui/brick/patches"
BR2_TARGET_GENERIC_HOSTNAME="brick"
BR2_TARGET_GENERIC_ISSUE="TrimUI Brick Linux"
BR2_ROOTFS_DEVICE_CREATION_DYNAMIC_MDEV=y
BR2_TARGET_GENERIC_GETTY_PORT="ttyS0"
BR2_ROOTFS_OVERLAY="$(BR2_EXTERNAL_BRICK_PATH)/board/trimui/brick/rootfs-overlay"
BR2_ROOTFS_POST_IMAGE_SCRIPT="$(BR2_EXTERNAL_BRICK_PATH)/board/trimui/brick/post-image.sh"
BR2_PACKAGE_BUSYBOX_SHOW_OTHERS=y
BR2_PACKAGE_KMOD=y
BR2_PACKAGE_KMOD_TOOLS=y
BR2_PACKAGE_EVTEST=y
BR2_PACKAGE_BRICK_GPU=y
BR2_TARGET_ROOTFS_CPIO=y
BR2_TARGET_ROOTFS_CPIO_GZIP=y
# BR2_TARGET_ROOTFS_TAR is not set
BR2_TARGET_ARM_TRUSTED_FIRMWARE=y
BR2_TARGET_ARM_TRUSTED_FIRMWARE_CUSTOM_GIT=y
BR2_TARGET_ARM_TRUSTED_FIRMWARE_CUSTOM_REPO_URL="https://github.com/ARM-software/arm-trusted-firmware.git"
BR2_TARGET_ARM_TRUSTED_FIRMWARE_CUSTOM_REPO_VERSION="510355478850fb9bb4b064554d3dc2416b8b4b96"
BR2_TARGET_ARM_TRUSTED_FIRMWARE_PLATFORM="sun50i_a133"
BR2_TARGET_UBOOT=y
BR2_TARGET_UBOOT_BUILD_SYSTEM_KCONFIG=y
BR2_TARGET_UBOOT_CUSTOM_GIT=y
BR2_TARGET_UBOOT_CUSTOM_REPO_URL="https://github.com/u-boot/u-boot.git"
BR2_TARGET_UBOOT_CUSTOM_REPO_VERSION="5e3b01c8466dbe45cd6a06299f8f4c7e8c1c2363"
BR2_TARGET_UBOOT_BOARD_DEFCONFIG="trimui-brick"
BR2_TARGET_UBOOT_NEEDS_DTC=y
BR2_TARGET_UBOOT_NEEDS_PYLIBFDT=y
BR2_TARGET_UBOOT_NEEDS_OPENSSL=y
BR2_TARGET_UBOOT_NEEDS_GNUTLS=y
BR2_TARGET_UBOOT_NEEDS_ATF_BL31=y
BR2_TARGET_UBOOT_SPL=y
BR2_TARGET_UBOOT_SPL_NAME="u-boot-sunxi-with-spl.bin"
BR2_PACKAGE_HOST_GENIMAGE=y
BR2_LINUX_KERNEL=y
BR2_LINUX_KERNEL_CUSTOM_GIT=y
BR2_LINUX_KERNEL_CUSTOM_REPO_URL="$(BR2_EXTERNAL_BRICK_PATH)/../linux"
BR2_LINUX_KERNEL_CUSTOM_REPO_VERSION="5cba4bd48b1b701ef5938e752d7b9d6375e7cff2"
BR2_LINUX_KERNEL_DEFCONFIG="trimui_brick"
BR2_LINUX_KERNEL_DTS_SUPPORT=y
BR2_LINUX_KERNEL_INTREE_DTS_NAME="allwinner/sun50i-a133-trimui-brick"
BR2_LINUX_KERNEL_NEEDS_HOST_OPENSSL=y

BR2_TOOLCHAIN_EXTERNAL_FORTRAN=y

BR2_TOOLCHAIN_EXTERNAL_OPENMP=y
BR2_PACKAGE_BRICK_DEVTOOLS=y
BR2_ROOTFS_POST_BUILD_SCRIPT="$(BR2_EXTERNAL_BRICK_PATH)/board/trimui/brick/post-build.sh"
BR2_PACKAGE_HOST_PYTHON3=y
BR2_PACKAGE_HOST_DOSFSTOOLS=y
BR2_PACKAGE_HOST_MTOOLS=y
BR2_PACKAGE_DROPBEAR=y
BR2_PACKAGE_ALSA_UTILS=y
BR2_PACKAGE_ALSA_UTILS_APLAY=y
BR2_PACKAGE_ALSA_UTILS_AMIXER=y
BR2_PACKAGE_BRICK_RADIO=y
BR2_PACKAGE_IW=y
BR2_PACKAGE_WPA_SUPPLICANT=y
BR2_PACKAGE_WPA_SUPPLICANT_CLI=y
BR2_PACKAGE_WIRELESS_REGDB=y
```

## package/brick-accelerator-qualification/Config.in
```kconfig
config BR2_PACKAGE_BRICK_ACCELERATOR_QUALIFICATION
	bool
	default y if BR2_BRICK_G2D_QUALIFICATION || BR2_BRICK_VE_QUALIFICATION || BR2_BRICK_VP9_QUALIFICATION
	select BR2_PACKAGE_LIBV4L
	select BR2_PACKAGE_LIBV4L_UTILS
	select BR2_PACKAGE_GSTREAMER1 if BR2_BRICK_VE_QUALIFICATION
	select BR2_PACKAGE_GSTREAMER1_INSTALL_TOOLS if BR2_BRICK_VE_QUALIFICATION
	select BR2_PACKAGE_GST1_PLUGINS_BASE if BR2_BRICK_VE_QUALIFICATION
	select BR2_PACKAGE_GST1_PLUGINS_BASE_PLUGIN_VIDEOCONVERTSCALE if BR2_BRICK_VE_QUALIFICATION
	select BR2_PACKAGE_GST1_PLUGINS_BAD if BR2_BRICK_VE_QUALIFICATION
	select BR2_PACKAGE_GST1_PLUGINS_BAD_PLUGIN_IVFPARSE if BR2_BRICK_VE_QUALIFICATION
	select BR2_PACKAGE_GST1_PLUGINS_BAD_PLUGIN_VIDEOPARSERS if BR2_BRICK_VE_QUALIFICATION
	select BR2_PACKAGE_GST1_PLUGINS_BAD_PLUGIN_V4L2CODECS if BR2_BRICK_VE_QUALIFICATION
	select BR2_PACKAGE_GSTREAMER1 if BR2_BRICK_VP9_QUALIFICATION
	select BR2_PACKAGE_GSTREAMER1_INSTALL_TOOLS if BR2_BRICK_VP9_QUALIFICATION
	select BR2_PACKAGE_GST1_PLUGINS_BASE if BR2_BRICK_VP9_QUALIFICATION
	select BR2_PACKAGE_GST1_PLUGINS_BASE_PLUGIN_VIDEOCONVERTSCALE if BR2_BRICK_VP9_QUALIFICATION
	select BR2_PACKAGE_GST1_PLUGINS_BAD if BR2_BRICK_VP9_QUALIFICATION
	select BR2_PACKAGE_GST1_PLUGINS_BAD_PLUGIN_IVFPARSE if BR2_BRICK_VP9_QUALIFICATION
	select BR2_PACKAGE_GST1_PLUGINS_BAD_PLUGIN_V4L2CODECS if BR2_BRICK_VP9_QUALIFICATION
	help
	  Deterministic V4L2 qualification entry points and fixtures. This
	  package is present only in an isolated accelerator profile.
```

## package/brick-bluetooth-identity/Config.in
```kconfig
config BR2_PACKAGE_BRICK_BLUETOOTH_IDENTITY
	bool "Brick Bluetooth identity"
	depends on BR2_PACKAGE_BLUEZ5_UTILS
	help
	  Apply and verify a provisioned, persistent XR829 public address before
	  Bluetooth services start. No address is generated by this package.
```

## package/brick-ce-trng-qualification/Config.in
```kconfig
config BR2_PACKAGE_BRICK_CE_TRNG_QUALIFICATION
	bool
	default y if BR2_BRICK_CE_TRNG_QUALIFICATION
	help
	  Public AF_ALG and hwrng qualification tools for the isolated A133
	  CE/TRNG profile.
```

## package/brick-controls/Config.in
```kconfig
config BR2_PACKAGE_BRICK_CONTROLS
	bool "Brick hardware controls"
	select BR2_PACKAGE_ALSA_LIB
	help
	  Volume keys, optional Fn mute and Start+L/R brightness shortcuts
	  with persistent settings.
```

## package/brick-data-grow/Config.in
```kconfig
config BR2_PACKAGE_BRICK_DATA_GROW
	bool "Brick data partition growth"
	help
	  Safely extend the Brick SD card's second MBR partition to the end of
	  the card before persistent data is mounted.
```

## package/brick-devtools/Config.in
```kconfig
config BR2_PACKAGE_BRICK_DEVTOOLS
	bool "Brick development transfer tools"
	help
	  Bounded USB serial uploads for firmware development.
```

## package/brick-emmc-recovery/Config.in
```kconfig
config BR2_PACKAGE_BRICK_EMMC_RECOVERY
	bool "Brick read-only eMMC recovery profile"
	help
	  Dedicated image enabling the measured A133 eMMC DDR52 mode.
	  It identifies the fitted device and forces its user and boot
	  block devices read-only before other board services start.
	  USB gadget recovery remains available. This is disabled by
	  default.
```

## package/brick-encoder-qualification/Config.in
```kconfig
config BR2_PACKAGE_BRICK_ENCODER_QUALIFICATION
	bool
	default y if BR2_BRICK_VE_QUALIFICATION || BR2_BRICK_COMBINED_ACCELERATOR_QUALIFICATION
	depends on BR2_BRICK_VE_QUALIFICATION || BR2_BRICK_COMBINED_ACCELERATOR_QUALIFICATION
	help
	  Install the bounded A133 H.264 and JPEG V4L2 qualification runner.
```

## package/brick-gpu/Config.in
```kconfig
config BR2_PACKAGE_BRICK_GPU
	bool "Brick GPU firmware and userspace"
	depends on BR2_aarch64 && BR2_TOOLCHAIN_USES_GLIBC
	select BR2_PACKAGE_HOST_PYTHON3
	select BR2_PACKAGE_HOST_PYTHON3_XZ
	select BR2_INSTALL_LIBSTDCPP
	help
	  DDK 1.19@6345021 for GE8300 BVNC 22.102.54.38, extracted
	  from the official TrimUI Brick 1.1.1 firmware archive.
```

## package/brick-power/Config.in
```kconfig
config BR2_PACKAGE_BRICK_POWER
	bool "Brick power controls"
	select BR2_PACKAGE_DBUS
	help
	  Six-second power-key hold and validated critical battery state
	  request orderly shutdown. Stock idle dim/backlight-off policy and
	  short power-key backlight control. Optional automatic s2idle is disabled
	  by default pending device qualification. Explicit and automatic s2idle
	  preserve audio, Bluetooth power and standard mood LED brightness.
```

## package/brick-radio/Config.in
```kconfig
config BR2_PACKAGE_BRICK_RADIO
	bool "Brick XR829 radio firmware"
	select BR2_PACKAGE_HOST_PYTHON3
	help
	  XR829 bootloader, Wi-Fi calibration/firmware and Bluetooth
	  firmware extracted from the official TrimUI Brick 1.1.1 archive.
```

## package/brick-scp/Config.in
```kconfig
config BR2_PACKAGE_BRICK_SCP
	bool "Brick SCP startup profile"
	select BR2_PACKAGE_HOST_PYTHON3
	help
	  Build the opt-in Brick SCP profile using the exact SCP and service
	  device tree extracted from the official firmware archive. The profile
	  includes bounded startup, mailbox loopback, the versioned native wake
	  ABI and the source support needed for stock-compatible system suspend.

config BR2_PACKAGE_BRICK_SCP_SYSTEM_SUSPEND
	bool "Brick SCP system-suspend profile"
	select BR2_PACKAGE_BRICK_SCP
	help
	  Expose the complete, default-off A133 PSCI system-suspend path. Select
	  this only as part of the paired deep firmware and kernel-DT profile.
```

## package/brick-wifi/Config.in
```kconfig
config BR2_PACKAGE_BRICK_WIFI
	bool "brick-wifi"
	depends on BR2_USE_MMU
	select BR2_PACKAGE_WPA_SUPPLICANT
	select BR2_PACKAGE_WPA_SUPPLICANT_CLI
	select BR2_PACKAGE_LIBCURL
	select BR2_PACKAGE_LIBCURL_CURL
	select BR2_PACKAGE_LIBCURL_FORCE_TLS
	select BR2_PACKAGE_CA_CERTIFICATES
	help
	  Single Wi-Fi product authority for radio state, network selection,
	  saved profiles, private addresses, connectivity and captive login.
```

## package/brick-wpewebkit/Config.in
```kconfig
config BR2_PACKAGE_BRICK_WPEWEBKIT
	bool "Brick WPE WebKit captive browser engine"
	depends on BR2_aarch64
	depends on BR2_USE_MMU
	depends on BR2_INSTALL_LIBSTDCPP
	depends on BR2_USE_WCHAR
	depends on BR2_TOOLCHAIN_HAS_THREADS_NPTL
	depends on BR2_TOOLCHAIN_HAS_SYNC_4
	depends on BR2_TOOLCHAIN_GCC_AT_LEAST_11
	depends on BR2_TOOLCHAIN_HEADERS_AT_LEAST_3_17
	depends on BR2_PACKAGE_LIBSECCOMP_ARCH_SUPPORTS
	depends on !BR2_STATIC_LIBS
	select BR2_HOST_CMAKE_AT_LEAST_3_20
	select BR2_PACKAGE_BUBBLEWRAP
	select BR2_PACKAGE_FONTCONFIG
	select BR2_PACKAGE_FREETYPE
	select BR2_PACKAGE_HARFBUZZ
	select BR2_PACKAGE_ICU
	select BR2_PACKAGE_JPEG
	select BR2_PACKAGE_LIBDRM
	select BR2_PACKAGE_LIBEPOXY
	select BR2_PACKAGE_LIBGCRYPT
	select BR2_PACKAGE_LIBINPUT
	select BR2_PACKAGE_LIBPNG
	select BR2_PACKAGE_LIBSECCOMP
	select BR2_PACKAGE_LIBSOUP3
	select BR2_PACKAGE_LIBTASN1
	select BR2_PACKAGE_LIBUDEV_ZERO
	select BR2_PACKAGE_LIBXKBCOMMON
	select BR2_PACKAGE_LIBXSLT
	select BR2_PACKAGE_MESA3D
	select BR2_PACKAGE_MESA3D_GALLIUM_DRIVER_SOFTPIPE
	select BR2_PACKAGE_MESA3D_OPENGL_EGL
	select BR2_PACKAGE_MESA3D_OPENGL_ES
	select BR2_PACKAGE_WEBP
	select BR2_PACKAGE_WEBP_DEMUX
	select BR2_PACKAGE_WEBP_MUX
	select BR2_PACKAGE_WOFF2
	select BR2_PACKAGE_XDG_DBUS_PROXY
	select BR2_PACKAGE_XKEYBOARD_CONFIG
	help
	  Pinned WPE WebKit 2.54 engine for the Brick captive browser.
	  This builds the upstream DRM WPEPlatform backend against Mesa
	  softpipe/GBM and libudev-zero with four narrow Brick integration
	  patches. It does not build Wayland, the legacy WPE API, a custom
	  WPEPlatform backend, or a second browser engine.
```
